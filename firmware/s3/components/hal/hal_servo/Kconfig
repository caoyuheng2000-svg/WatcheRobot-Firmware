## firmware/s3/components/hal/hal_servo/Kconfig
```kconfig
menu "Watcher HAL Servo"

    config WATCHER_SERVO_USE_MCU_MOTION_BRIDGE
        bool "Mirror smooth/sync/cancel calls to MCU motion service"
        default n
        help
            Enables a compatibility bridge that translates smooth motion,
            synchronized motion, and cancel requests into mcu_motion_service
            requests. The local LEDC servo path remains active and is still
            the safe default when this option is disabled or the bridge is
            unavailable.

    config WATCHER_SERVO_X_GPIO
        int "Servo X axis GPIO number"
        default 19
        help
            GPIO pin for X-axis servo PWM output.
            Default 19 (previously UART TX to MCU, repurposed in v2.0).

    config WATCHER_SERVO_Y_GPIO
        int "Servo Y axis GPIO number"
        default 20
        help
            GPIO pin for Y-axis servo PWM output.
            Default 20 (previously UART RX from MCU, repurposed in v2.0).

    config WATCHER_SERVO_Y_MIN_DEG
        int "Servo Y axis minimum angle (degrees)"
        default 90
        range 0 180
        help
            Mechanical protection lower limit for Y axis (prevents hardware damage).

    config WATCHER_SERVO_Y_MAX_DEG
        int "Servo Y axis maximum angle (degrees)"
        default 150
        range 0 180
        help
            Mechanical protection upper limit for Y axis.

    config WATCHER_SERVO_SMOOTH_STEP_MS
        int "Smooth move step interval (ms)"
        default 10
        range 5 50
        help
            Time between interpolation steps during smooth servo movement.

endmenu
```

## firmware/s3/components/protocols/mcu_link/Kconfig
```kconfig
menu "MCU Link"

config WATCHER_MCU_LINK_UART_ENABLE
    bool "Enable runtime UART transport for STM32 coprocessor link"
    default n
    help
        Enables the UART transport scaffold for the STM32 coprocessor runtime
        link. Keep this disabled while the local LEDC servo backend still owns
        GPIO19/GPIO20. Enable it once the board is ready to hand those pins to
        the coprocessor UART.

if WATCHER_MCU_LINK_UART_ENABLE

config WATCHER_MCU_LINK_UART_PORT_NUM
    int "UART port number"
    range 0 2
    default 2
    help
        Dedicated UART controller used for the STM32 runtime link.

config WATCHER_MCU_LINK_UART_TX_GPIO
    int "UART TX GPIO"
    range -1 48
    default 19
    help
        ESP32-S3 TX GPIO for the STM32 runtime link.

config WATCHER_MCU_LINK_UART_RX_GPIO
    int "UART RX GPIO"
    range -1 48
    default 20
    help
        ESP32-S3 RX GPIO for the STM32 runtime link.

config WATCHER_MCU_LINK_UART_BAUD_RATE
    int "UART baud rate"
    range 9600 3000000
    default 921600
    help
        Runtime baud rate for the STM32 coprocessor UART link.

config WATCHER_MCU_LINK_UART_RX_BUFFER
    int "UART RX buffer size"
    range 256 65536
    default 4096
    help
        UART driver RX ring buffer size in bytes.

config WATCHER_MCU_LINK_UART_TX_BUFFER
    int "UART TX buffer size"
    range 0 65536
    default 4096
    help
        UART driver TX ring buffer size in bytes.

endif

endmenu
```

## firmware/s3/components/protocols/ws_client/Kconfig
```kconfig
menu "Watcher WebSocket Client"

    config WATCHER_WS_AUDIO_QUEUE_DEPTH
        int "Audio upload queue depth"
        default 4
        range 2 8
        help
            Number of 1920-byte audio upload frames staged in PSRAM. The
            protocol fragments payloads, so four frames keeps jitter tolerance
            while reducing always-reserved PSRAM.

    config WATCHER_WS_AUDIO_STATS_LOG_INTERVAL_FRAMES
        int "Audio upload stats log interval"
        default 60
        range 0 1000
        help
            Emit one websocket audio upload stats log every N sent frames.
            Set to 0 to disable periodic audio upload stats logs.

    config WATCHER_WS_TTS_QUEUE_DEPTH
        int "TTS playback queue depth"
        default 16
        range 2 16
        help
            Number of 4096-byte TTS frames staged in PSRAM before playback.
            Sixteen frames provide about 1.3 seconds of playback buffering at
            24kHz 16-bit mono, which absorbs long-response websocket bursts
            without moving the audio queue back to a larger default.

    config WATCHER_WS_TTS_MAX_PAYLOAD_BYTES
        int "Maximum inbound TTS payload bytes"
        default 32768
        range 4096 65536
        help
            Maximum accepted WSPK audio payload from the desktop/server in one
            WebSocket message. Larger payloads are rejected before they can
            flood the playback queue.

    config WATCHER_WS_TTS_ENQUEUE_TIMEOUT_MS
        int "TTS enqueue backpressure timeout (ms)"
        default 1500
        range 100 5000
        help
            Maximum time a websocket receive callback waits for a free TTS
            playback slot before dropping the current inbound TTS chunk. The
            wait applies TCP backpressure when server-side TTS delivery is
            faster than local I2S playback.

endmenu
```

## firmware/s3/components/services/voice_service/Kconfig
```kconfig
menu "Watcher Voice Service"

    config WATCHER_ENABLE_WAKE_WORD
        bool "Enable local wake word detection"
        default y
        depends on IDF_TARGET_ESP32S3 && SPIRAM && USE_WAKENET
        help
            Enable offline wake word detection using Espressif ESP-SR AFE and
            the selected WakeNet model. Audio stays at 16 kHz while idle so the
            detector can run continuously.

    if WATCHER_ENABLE_WAKE_WORD

    config WATCHER_WAKE_WORD_HIGH_PERF_MODE
        bool "Use high performance AFE mode"
        default n
        help
            Use SR_MODE_HIGH_PERF instead of SR_MODE_LOW_COST. This can improve
            detection robustness but increases CPU and memory pressure.

    config WATCHER_WAKE_WORD_SENSITIVE_MODE
        bool "Use sensitive WakeNet threshold"
        default n
        help
            Use DET_MODE_95 instead of DET_MODE_90. This is more sensitive and
            may increase false wakeups.

    config WATCHER_WAKE_WORD_TASK_STACK_SIZE
        int "Wake word detection task stack size"
        range 3072 8192
        default 4096

    config WATCHER_WAKE_WORD_TASK_PRIORITY
        int "Wake word detection task priority"
        range 3 10
        default 6

    config WATCHER_WAKE_WORD_AFE_CORE
        int "AFE preferred core"
        range 0 1
        default 1

    config WATCHER_WAKE_WORD_AFE_PRIORITY
        int "AFE preferred priority"
        range 1 10
        default 3

    config WATCHER_WAKE_WORD_AFE_RINGBUF_SIZE
        int "AFE ring buffer size"
        range 10 100
        default 50

    config WATCHER_VAD_SILENCE_TIMEOUT_MS
        int "VAD silence timeout after wake word (ms)"
        range 0 10000
        default 1200
        help
            Stop wake-word-triggered recording after this much silence. Set to
            0 to disable automatic silence stop.

    config WATCHER_VAD_RMS_THRESHOLD
        int "VAD RMS threshold"
        range 50 5000
        default 450

    config WATCHER_VAD_MIN_SPEECH_MS
        int "VAD minimum speech duration (ms)"
        range 0 5000
        default 600

    endif

endmenu
```
